## package/clutter/Config.in
```kconfig
config BR2_PACKAGE_CLUTTER
	bool clutter
	select BR2_PACKAGE_COGL
	select BR2_PACKAGE_ATK
	help
	  A software library for creating fast, compelling, portable, and dynamic graphical user interfaces
```

## package/cogl/Config.in
```kconfig
config BR2_PACKAGE_COGL
	bool cogl
	help
	  A hardware accelerated 3D graphics API
```

## package/harfbuzz/Config.in
```kconfig
config BR2_PACKAGE_HARFBUZZ
	bool harfbuzz
	select BR2_PACKAGE_CAIRO
	select BR2_PACKAGE_FREETYPE
	help
	  HarfBuzz text shaping library
```

## package/mlplayer/Config.in
```kconfig
config BR2_PACKAGE_MLPLAYER
	bool "mlplayer"
	help
		Metrological's simple player (experiment)
		http://www.metrological.com
```

## package/webkit-clutter/Config.in
```kconfig
config BR2_PACKAGE_WEBKIT_CLUTTER
	bool "webkit-clutter"
	help
	  A Clutter port of webkit
```
